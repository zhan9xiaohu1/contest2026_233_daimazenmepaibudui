## app/hello_app/Kconfig
```kconfig
#
# For a description of the syntax of this configuration file,
# see the file kconfig-language.txt in the NuttX tools repository.
#

config LVX_USE_DEMO_CONTEST2026_000_HELLO_APP
	bool "AI Companion - 智爱陪伴AI老人陪伴守护终端"
	default n
	---help---
		Enable the AI companion app for elderly care.

config DEBUG_AI_COMPANION
	bool "Enable AI Companion debug output"
	default n
	depends on LVX_USE_DEMO_CONTEST2026_000_HELLO_APP
	---help---
		Enable debug log output for AI companion state machine.

config DEBUG_AI_AUDIO
	bool "Enable AI Audio debug output"
	default n
	depends on LVX_USE_DEMO_CONTEST2026_000_HELLO_APP
	---help---
		Enable debug log output for AI audio module.

config DEBUG_AI_LLM
	bool "Enable AI LLM debug output"
	default n
	depends on LVX_USE_DEMO_CONTEST2026_000_HELLO_APP
	---help---
		Enable debug log output for AI LLM module.

config AI_LLM_API_KEY
	string "LLM API Key"
	default ""
	depends on LVX_USE_DEMO_CONTEST2026_000_HELLO_APP
	---help---
		API key for LLM service.

config AI_LLM_MODEL
	string "LLM Model Name"
	default "gpt-3.5-turbo"
	depends on LVX_USE_DEMO_CONTEST2026_000_HELLO_APP
	---help---
		LLM model name to use.

config DEBUG_AI_SOUND_DETECT
	bool "Enable AI Sound Detection debug output"
	default n
	depends on LVX_USE_DEMO_CONTEST2026_000_HELLO_APP
	---help---
		Enable debug log output for AI sound detection module.

config DEBUG_AI_CARE
	bool "Enable AI Care debug output"
	default n
	depends on LVX_USE_DEMO_CONTEST2026_000_HELLO_APP
	---help---
		Enable debug log output for AI care module.
```

## app/zhi_ai/Kconfig
```kconfig
# 智爱陪伴 - Kconfig
config LVX_USE_CONTEST2026_233_ZHI_AI
	bool "智爱陪伴 AI Companion for Elderly"
	default n
	---help---
		Enable the 智爱陪伴 (ZhiAi Companion) application.
		An AI companion robot for elderly people based on
		openvela + SF32LB52-DevKit-LCD.

if LVX_USE_CONTEST2026_233_ZHI_AI

config ZHI_AI_PROGNAME
	string "Program name"
	default "zhi_ai"

config ZHI_AI_PRIORITY
	int "Task priority"
	default 100

config ZHI_AI_STACKSIZE
	int "Stack size"
	default 8192

endif
```
